## plugins/skills/add-library/templates/Kconfig
```kconfig
# SPDX-License-Identifier: __license__
# Copyright (c) __year__ __author__

rsource "lib/Kconfig"
```

## plugins/skills/add-library/templates/module/Kconfig
```kconfig
# SPDX-License-Identifier: __license__
# Copyright (c) __year__ __author__

config __MODULE__
  bool "Enable the __Module__ Swift library"
  depends on SWIFT
  help
    __description__

    Use it from Swift with `import __Module__`.
```

## plugins/skills/new-project/templates/west.yml
```yaml
# SPDX-License-Identifier: __license__
# Copyright (c) __year__ __author__

manifest:
  version: "1.2"

  self:
    path: __name__

  remotes:
    - name: zephyr-source
      url-base: https://github.com/__zephyr-owner__
    - name: zephyr-lang-swift-source
      url-base: https://github.com/anselmes

  projects:
    - name: zephyr
      remote: zephyr-source
      repo-path: __zephyr-repo__
      revision: __zephyr-rev__
      import:
        name-allowlist:
          - __hal-module__ # repeat this line for each HAL module the board needs
          - picolibc # Built as a module so headers are visible to Swift
    # Declared here, not imported: the Zephyr fork keeps Swift in its disabled `optional` group at `main`.
    - name: zephyr-lang-swift
      remote: zephyr-lang-swift-source
      revision: __swift-rev__
      path: modules/lang/swift
```

## samples/lib/hello/Kconfig
```kconfig
# SPDX-License-Identifier: GPL-3.0
# Copyright (c) 2025 Schubert Anselme <schubert@anselm.es>

# Kconfig for the Hello sample library.

config HELLO
  bool "Enable Hello Swift Sample Module"
  help
    Build the Hello sample library, which an application imports with
    `import Hello`. It provides hello(timeout:) and Hello.run(timeout:), which
    print a greeting and then `still running...` at a fixed interval and never
    return.

    Requires CONFIG_SWIFT=y. Disable it to leave the library out of the build.
```
